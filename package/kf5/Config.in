## package/kf5/Config.in
```kconfig
menuconfig BR2_PACKAGE_KF5
	bool "KF5"
	depends on BR2_PACKAGE_QT5
	help
	  This option enables the KF5 KDE Frameworks. Sub-options
	  allow to select which modules should be built.

	  https://techbase.kde.org/KDE_Frameworks

if BR2_PACKAGE_KF5
source "package/kf5/kf5-extra-cmake-modules/Config.in"
source "package/kf5/kf5-karchive/Config.in"
source "package/kf5/kf5-kauth/Config.in"
source "package/kf5/kf5-kbookmarks/Config.in"
source "package/kf5/kf5-kcodecs/Config.in"
source "package/kf5/kf5-kcompletion/Config.in"
source "package/kf5/kf5-kconfig/Config.in"
source "package/kf5/kf5-kconfigwidgets/Config.in"
source "package/kf5/kf5-kcoreaddons/Config.in"
source "package/kf5/kf5-kcrash/Config.in"
source "package/kf5/kf5-kdbusaddons/Config.in"
source "package/kf5/kf5-kddockwidgets/Config.in"
source "package/kf5/kf5-kglobalaccel/Config.in"
source "package/kf5/kf5-kguiaddons/Config.in"
source "package/kf5/kf5-ki18n/Config.in"
source "package/kf5/kf5-kiconthemes/Config.in"
source "package/kf5/kf5-kio/Config.in"
source "package/kf5/kf5-kitemmodels/Config.in"
source "package/kf5/kf5-kitemviews/Config.in"
source "package/kf5/kf5-kjobwidgets/Config.in"
source "package/kf5/kf5-knotifications/Config.in"
source "package/kf5/kf5-kservice/Config.in"
source "package/kf5/kf5-phonon/Config.in"
source "package/kf5/kf5-solid/Config.in"
source "package/kf5/kf5-sonnet/Config.in"
source "package/kf5/kf5-ktextwidgets/Config.in"
source "package/kf5/kf5-kwidgetsaddons/Config.in"
source "package/kf5/kf5-kwindowsystem/Config.in"
source "package/kf5/kf5-kxmlgui/Config.in"
source "package/kf5/kf5-modemmanager-qt/Config.in"
source "package/kf5/kf5-networkmanager-qt/Config.in"
endif
```

## package/kf5/kf5-elfutils-minimal/Config.in
```kconfig
config BR2_PACKAGE_KF5_ELFUTILS_MINIMAL
	bool "kf5-elfutils-minimal"
	select BR2_PACKAGE_BZIP2
	select BR2_PACKAGE_XZ
	select BR2_PACKAGE_ZSTD
	help
	  KF5 is a set of Qt framework addons, extending Qt in
	  various ways, not only restricted in helping integration
	  in KDE.
```

## package/kf5/kf5-kbookmarks/Config.in
```kconfig
config BR2_PACKAGE_KF5_KBOOKMARKS
	bool "kf5-kbookmarks"
	select BR2_PACKAGE_KF5_EXTRA_CMAKE_MODULES
	help
	  KF5 is a set of Qt framework addons, extending Qt in
	  various ways, not only restricted in helping integration
	  in KDE.
```

## package/kf5/kf5-kconfigwidgets/Config.in
```kconfig
config BR2_PACKAGE_KF5_KCONFIGWIDGETS
	bool "kf5-kconfigwidgets"
	select BR2_PACKAGE_KF5_EXTRA_CMAKE_MODULES
	select BR2_PACKAGE_KF5_KGUIADDONS
	select BR2_PACKAGE_KF5_KWIDGETSADDONS
	help
	  KF5 is a set of Qt framework addons, extending Qt in
	  various ways, not only restricted in helping integration
	  in KDE.
```

## package/kf5/kf5-kcrash/Config.in
```kconfig
config BR2_PACKAGE_KF5_KCRASH
	bool "kf5-kcrash"
	select BR2_PACKAGE_KF5_EXTRA_CMAKE_MODULES
	select BR2_PACKAGE_KF5_KWINDOWSYSTEM
	help
	  KF5 is a set of Qt framework addons, extending Qt in
	  various ways, not only restricted in helping integration
	  in KDE.
```

## package/kf5/kf5-kddockwidgets/Config.in
```kconfig
config BR2_PACKAGE_KF5_KDDOCKWIDGETS
	bool "kf5-kddockwidgets"
	select BR2_PACKAGE_KF5_EXTRA_CMAKE_MODULES
	help
	  KF5 is a set of Qt framework addons, extending Qt in
	  various ways, not only restricted in helping integration
	  in KDE.
```

## package/kf5/kf5-kglobalaccel/Config.in
```kconfig
config BR2_PACKAGE_KF5_KGLOBALACCEL
	bool "kf5-kglobalaccel"
	select BR2_PACKAGE_KF5_EXTRA_CMAKE_MODULES
	select BR2_PACKAGE_KF5_KCRASH
	select BR2_PACKAGE_KF5_KDBUSADDONS
	
	help
	  KF5 is a set of Qt framework addons, extending Qt in
	  various ways, not only restricted in helping integration
	  in KDE.
```

## package/kf5/kf5-ki18n/Config.in
```kconfig
config BR2_PACKAGE_KF5_KI18N
	bool "kf5-ki18n"
	select BR2_PACKAGE_KF5_EXTRA_CMAKE_MODULES
	select BR2_PACKAGE_QT5SCRIPT
	select BR2_PACKAGE_QT5DECLARATIVE
	help
	  KF5 is a set of Qt framework addons, extending Qt in
	  various ways, not only restricted in helping integration
	  in KDE.
```

## package/kf5/kf5-kiconthemes/Config.in
```kconfig
config BR2_PACKAGE_KF5_KICONTHEMES
	bool "kf5-kiconthemes"
	select BR2_PACKAGE_KF5_EXTRA_CMAKE_MODULES
	select BR2_PACKAGE_QT5SVG
	select BR2_PACKAGE_KF5_KITEMVIEWS
	select BR2_PACKAGE_KF5_KGUIADDONS
	help
	  KF5 is a set of Qt framework addons, extending Qt in
	  various ways, not only restricted in helping integration
	  in KDE.
```

## package/kf5/kf5-knotifications/Config.in
```kconfig
config BR2_PACKAGE_KF5_KNOTIFICATIONS
	bool "kf5-knotifications"
	select BR2_PACKAGE_KF5_EXTRA_CMAKE_MODULES
	help
	  KF5 is a set of Qt framework addons, extending Qt in
	  various ways, not only restricted in helping integration
	  in KDE.
```

## package/kf5/kf5-kparts/Config.in
```kconfig
config BR2_PACKAGE_KF5_KPARTS
	bool "kf5-kparts"
	select BR2_PACKAGE_KF5_EXTRA_CMAKE_MODULES
	#select BR2_PACKAGE_QT5BASE_DBUS
	help
	  KF5 is a set of Qt framework addons, extending Qt in
	  various ways, not only restricted in helping integration
	  in KDE.
```

## package/kf5/kf5-kservice/Config.in
```kconfig
config BR2_PACKAGE_KF5_KSERVICE
	bool "kf5-kservice"
	select BR2_PACKAGE_KF5_EXTRA_CMAKE_MODULES
	select BR2_PACKAGE_KF5_KCRASH
	select BR2_PACKAGE_KF5_KDBUSADDONS
	help
	  KF5 is a set of Qt framework addons, extending Qt in
	  various ways, not only restricted in helping integration
	  in KDE.
```

## package/kf5/kf5-kwindowsystem/Config.in
```kconfig
config BR2_PACKAGE_KF5_KWINDOWSYSTEM
	bool "kf5-kwindowsystem"
	select BR2_PACKAGE_KF5_EXTRA_CMAKE_MODULES
	select BR2_PACKAGE_QT5X11EXTRAS
	select BR2_PACKAGE_XLIB_LIBXRENDER
	select BR2_PACKAGE_XLIB_LIBXFIXES
	help
	  KF5 is a set of Qt framework addons, extending Qt in
	  various ways, not only restricted in helping integration
	  in KDE.
```

## package/kf5/kf5-kxmlgui/Config.in
```kconfig
config BR2_PACKAGE_KF5_KXMLGUI
	bool "kf5-kxmlgui"
	select BR2_PACKAGE_KF5_EXTRA_CMAKE_MODULES
	select BR2_PACKAGE_KF5_KTEXTWIDGETS
	select BR2_PACKAGE_KF5_KGLOBALACCEL
	select BR2_PACKAGE_LIBOPENSSL
	help
	  KF5 is a set of Qt framework addons, extending Qt in
	  various ways, not only restricted in helping integration
	  in KDE.
```

## package/kf5/kf5-phonon/Config.in
```kconfig
config BR2_PACKAGE_KF5_PHONON
	bool "kf5-phonon"
	select BR2_PACKAGE_KF5_EXTRA_CMAKE_MODULES
	help
	  KF5 is a set of Qt framework addons, extending Qt in
	  various ways, not only restricted in helping integration
	  in KDE.
```

## package/kf5/kf5-solid/Config.in
```kconfig
config BR2_PACKAGE_KF5_SOLID
	bool "kf5-solid"
	select BR2_PACKAGE_KF5_EXTRA_CMAKE_MODULES
	select BR2_PACKAGE_UTIL_LINUX_LIBS
	select BR2_PACKAGE_EUDEV
	help
	  KF5 is a set of Qt framework addons, extending Qt in
	  various ways, not only restricted in helping integration
	  in KDE.
```
